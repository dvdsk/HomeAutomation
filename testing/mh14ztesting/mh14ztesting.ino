#include <stdio.h>

static const byte REQUESTCO2[9] = {0xFF,0x01,0x86,0x00,0x00,0x00,0x00,0x00,0x79}; 
char buffer[3];
int bufferLen;


inline byte calculate_checkV(const byte data[9]){
	byte checkV;	

	checkV = (data[1]+data[2]+data[3]+data[4]+data[5]+data[6]+data[7]);
	
	checkV = 0XFF - checkV +1;

	return checkV;
}			


int readCO2(Stream& sensorSerial){
  //reads awnser from Co2 sensor that resides in the hardware serial buffer
  //this can be called some time after reqeusting the data thus it is not 
  //needed to wait for a reply after the request, Will also not 
  //block if no reply present but return -1 instead

  char response[9]; //changed was char, byte is better prevents issue with char
                    //in reading out the array in hex (like values such as 
                    //FFFFFFF86 instead of 86) //again to char since makefile
                    //wants it to be char really badly
  uint8_t responseHigh;
  uint8_t responseLow;
  int ppm;
  
  while (sensorSerial.available() > 8){
    if (!sensorSerial.read() == 0XFF){//check if reply from sensor in buffer
      sensorSerial.read();
    }
    else{
      sensorSerial.readBytes(response+1, 8);
      responseHigh = (uint8_t) response[2];
      responseLow = (uint8_t) response[3];			
			ppm = ((uint16_t)responseHigh)*256+(uint16_t)responseLow;
			Serial.print("\nCo2:");
			Serial.print(ppm);			
			Serial.print(" (ppm)\t\ttemp:");
			Serial.print((uint8_t)response[4]-40);
			Serial.print(" (celcius)"); 
  
			Serial.print("\trecieved check value: ");
			Serial.print((uint8_t)response[8]); 
			Serial.print("\tcalculated check value: ");
			Serial.print(calculate_checkV((uint8_t*)response));	
					
			return ppm;
    }
  }
  return -1;
}

inline uint8_t reverse_byte(uint8_t x)
{
  static const uint8_t table[] = {
      0x00, 0x80, 0x40, 0xc0, 0x20, 0xa0, 0x60, 0xe0,
      0x10, 0x90, 0x50, 0xd0, 0x30, 0xb0, 0x70, 0xf0,
      0x08, 0x88, 0x48, 0xc8, 0x28, 0xa8, 0x68, 0xe8,
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      0x1f, 0x9f, 0x5f, 0xdf, 0x3f, 0xbf, 0x7f, 0xff,
  };
  return table[x];
}

void calibrateCO2(Stream& sensorSerial, int calibrationValue){

	Serial.print("\ncalibration sensor to: ");
	Serial.print(calibrationValue);
	Serial.print("ppm, please wait for 5 seconds\n");

	byte highV = (byte)(uint16_t(calibrationValue) >> 8);
	byte lowV = (byte)(calibrationValue);

	byte data[9] = {0xFF, 0x88, 0x88, highV, lowV, 0, 0, 0, 0};
	byte checkV = calculate_checkV(data);
	data[8] = checkV;
	
	Serial.println(data[4]);
	Serial.println(data[3]);

/*	static const byte setZeroPoint[9] = {0xFF, 0x87, 0x87, 0, 0, 0, 0, 0, 0xf2};*/
/*	static const byte data2[9] = {0xFF, 0x87, 0x87, 0, 0, 0, 0, 0, 0};*/
/*	byte checkV2 = calculate_checkV(data2);*/
/*	Serial.print("checkvalue in package we sent is:");	*/
/*	Serial.print(checkV2);*/
/*	Serial.print("\n");*/

	sensorSerial.write(data, 9);
	delay(5000);
	Serial.print("Sensor calibration complete! Below are new readings using the "
							 "calibration\nif you want to calibrate again enter a new CO2 concentration\n\n");
}

void setup()
{ 
	bufferLen = 0;  

	Serial.begin(115200); //Open serial connection to report values to host
  Serial1.begin(9600);  //Opens the second serial port with a baud of 9600 
                       //connect TX from MH Co2 sensor to TX1 on arduino etc
  
  Serial.print("CO2 calibration programm started\nplease put the CO2 sensor "
							 "outside and wait till its temperature and CO2 readings stabilise\n"
							 "then enter the outside CO2 concentration in ppm. Without reference 400 ppm can be assumed\n\n");
}


void loop(){
  
	while (Serial.available() >0 ){
		char c = Serial.read(); //gets one byte from serial buffer
		buffer[bufferLen] = c;
		bufferLen++;
  }
  if (bufferLen >0) {
		int concentration;		
		sscanf(buffer, "%d", &concentration);
		calibrateCO2(Serial1, concentration);
		bufferLen = 0;
	}
	
	Serial1.write(REQUESTCO2,9);// request the CO2 sensor to do a reading	
	readCO2(Serial1);
	delay(1000);

}
